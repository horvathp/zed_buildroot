## board/zed/zed.its
```
/dts-v1/;

/ {
	description = "FIT Image for the Zed";
	magic = "ITB ZED";
	#address-cells = <1>;
	images {

		fdt-1 {
			description = "Flattened Device Tree blob";
			data = /incbin/("./system.dtb");
			type = "flat_dt";
			arch = "arm";
			compression = "none";
			hash-1 {
				algo = "sha256";
			};
		};

		fpga-1 {
			description = "FPGA";
			data = /incbin/("./system.bit");
			type = "fpga";
			arch = "arm";
			compression = "none";
			load = <0xF000000>;
			hash-1 {
				algo = "sha256";
			};
		};

		kernel-1 {
			description = "Linux";
			data = /incbin/("./zImage");
			type = "kernel";
			arch = "arm";
			os = "linux";
			load = <0x00200000>;
            entry = <0x00200000>;
			compression = "none";
			hash-1 {
				algo = "sha256";
			};
		};

		ramdisk-1 {
			description = "Ramdisk";
			data = /incbin/("./rootfs.cpio.gz");
			type = "ramdisk";
			arch = "arm";
			os = "linux";
			compression = "gzip";
			hash-1 {
				algo = "sha256";
			};
		};

	};

	configurations {
		default = "config-0";
		config-0 {
			description = "Linux default bitfile";
			fdt = "fdt-1";
			kernel = "kernel-1";
			ramdisk = "ramdisk-1";
			fpga = "fpga-1";
		};

	};
};
```

## configs/zynq_zed_defconfig
```kconfig
BR2_arm=y
BR2_cortex_a9=y
BR2_ARM_ENABLE_NEON=y
BR2_ARM_ENABLE_VFP=y
BR2_TOOLCHAIN_EXTERNAL=y
BR2_TOOLCHAIN_EXTERNAL_CUSTOM=y
BR2_TOOLCHAIN_EXTERNAL_PREINSTALLED=y
BR2_TOOLCHAIN_EXTERNAL_PATH="/usr/local/arm-none-linux-gnueabihf"
BR2_TOOLCHAIN_EXTERNAL_GLIBC=y
BR2_PACKAGE_HAS_TOOLCHAIN_EXTERNAL=y
BR2_PACKAGE_PROVIDES_TOOLCHAIN_EXTERNAL="toolchain-external-custom"
BR2_TOOLCHAIN_EXTERNAL_PREFIX="arm-none-linux-gnueabihf"
BR2_TOOLCHAIN_EXTERNAL_BOOTLIN_ARCH_SUPPORTS=y
BR2_TOOLCHAIN_EXTERNAL_CUSTOM_PREFIX="arm-none-linux-gnueabihf"
BR2_TOOLCHAIN_EXTERNAL_GCC_10=y
BR2_TOOLCHAIN_EXTERNAL_HEADERS_4_20=y
BR2_TOOLCHAIN_EXTERNAL_CUSTOM_GLIBC=y
BR2_TOOLCHAIN_EXTERNAL_HAS_SSP=y
BR2_TOOLCHAIN_EXTERNAL_HAS_SSP_STRONG=y
BR2_TOOLCHAIN_EXTERNAL_CXX=y
BR2_TOOLCHAIN_EXTERNAL_INET_RPC=n
BR2_PACKAGE_HOST_GDB_ARCH_SUPPORTS=y
BR2_TARGET_GENERIC_GETTY_PORT="ttyPS0"
BR2_ROOTFS_POST_IMAGE_SCRIPT="$(BR2_EXTERNAL_ZED_PATH)/board/zed/post-image.sh"
BR2_ROOTFS_POST_SCRIPT_ARGS="$(BR2_EXTERNAL_ZED_PATH)/board/zed"
BR2_LINUX_KERNEL=y
BR2_LINUX_KERNEL_CUSTOM_GIT=y
BR2_LINUX_KERNEL_CUSTOM_REPO_URL="https://github.com/analogdevicesinc/linux"
BR2_LINUX_KERNEL_CUSTOM_REPO_VERSION="adi-5.10.0"
BR2_PACKAGE_HOST_LINUX_HEADERS_CUSTOM_5_10=y
BR2_LINUX_KERNEL_USE_CUSTOM_CONFIG=y
BR2_LINUX_KERNEL_CUSTOM_CONFIG_FILE="$(BR2_EXTERNAL_ZED_PATH)/zedboard/linux/linux.config"
BR2_LINUX_KERNEL_UIMAGE=y
BR2_LINUX_KERNEL_UIMAGE_LOADADDR="0x8000"
BR2_LINUX_KERNEL_DTS_SUPPORT=y
BR2_LINUX_KERNEL_USE_CUSTOM_DTS=y
BR2_LINUX_KERNEL_CUSTOM_DTS_PATH="$(BR2_EXTERNAL_ZED_PATH)/zedboard/dts/devicetree.dts $(BR2_EXTERNAL_ZED_PATH)/zedboard/dts/pcw.dtsi $(BR2_EXTERNAL_ZED_PATH)/zedboard/dts/pl.dtsi"
BR2_TARGET_ROOTFS_CPIO=y
BR2_TARGET_ROOTFS_CPIO_GZIP=y
BR2_TARGET_ROOTFS_CPIO_UIMAGE=y
BR2_TARGET_UBOOT=y
BR2_TARGET_UBOOT_BUILD_SYSTEM_KCONFIG=y
BR2_TARGET_UBOOT_CUSTOM_GIT=y
BR2_TARGET_UBOOT_CUSTOM_REPO_URL="https://github.com/Xilinx/u-boot-xlnx.git"
#BR2_TARGET_UBOOT_CUSTOM_REPO_VERSION="xilinx-v2018.2"
#BR2_TARGET_UBOOT_BOARD_DEFCONFIG="zynq_zed"
BR2_TARGET_UBOOT_CUSTOM_REPO_VERSION="xlnx_rebase_v2021.01"
BR2_TARGET_UBOOT_USE_CUSTOM_CONFIG=y
BR2_TARGET_UBOOT_CUSTOM_CONFIG_FILE="$(BR2_EXTERNAL_ZED_PATH)/uboot/zynq_zed_config"
BR2_TARGET_UBOOT_NEEDS_DTC=y
BR2_TARGET_UBOOT_NEEDS_OPENSSL=y
BR2_TARGET_UBOOT_FORMAT_IMG=y
BR2_TARGET_UBOOT_SPL=y
BR2_TARGET_UBOOT_SPL_NAME="spl/boot.bin"
BR2_PACKAGE_HOST_DOSFSTOOLS=y
BR2_PACKAGE_HOST_GENIMAGE=y
BR2_PACKAGE_HOST_MTOOLS=y
BR2_PACKAGE_LINUX_TOOLS_GPIO=y
```
